## platforms/esp32/components/husarnet_core/Kconfig
```kconfig
menu "Husarnet"
    choice HUSARNET_LOG_LEVEL
        bool "Default Husarnet log verbosity"
        default HUSARNET_LOG_LEVEL_WARN
        help
            Specify how much output to see in logs by default.

        config HUSARNET_LOG_LEVEL_NONE
            bool "No output"

        config HUSARNET_LOG_LEVEL_ERROR
            bool "Error"
        config HUSARNET_LOG_LEVEL_WARN
            bool "Warning"
        config HUSARNET_LOG_LEVEL_INFO
            bool "Info"
        config HUSARNET_LOG_LEVEL_DEBUG
            bool "Debug"
    endchoice

    # Levels are set according to the "husarnet/logging.h" LogLevel values
    config HUSARNET_LOG_LEVEL
        string
        default "0" if HUSARNET_LOG_LEVEL_NONE
        default "1" if HUSARNET_LOG_LEVEL_ERROR
        default "3" if HUSARNET_LOG_LEVEL_WARN
        default "4" if HUSARNET_LOG_LEVEL_INFO
        default "5" if HUSARNET_LOG_LEVEL_DEBUG
    
    config HUSARNET_FQDN
        string "Husarnet FQDN"
        default "prod.husarnet.com"
        help
            The FQDN of the Husarnet setup server. Can be changed for beta, testing and custom deployments.
    
    config HUSARNET_NGSOCKET_TASK_PRIORITY
        int "NgSocket task priority"
        range 1 17
        default 17
        help
            Sets packet processing task priority. Should be set higher than config, heartbeat and eventbus task priorities.

    config HUSARNET_CONFIG_MANAGER_TASK_PRIORITY
        int "ConfigManager task priority"
        range 1 16
        default 16
        help
            Sets configuration manager task priority. Should be set lower than ngsocket task priority.

    config HUSARNET_EVENTBUS_TASK_PRIORITY
        int "EventBus task priority"
        range 1 15
        default 5
        help
            Sets websocket event bus task priority. Should be set lower than ngsocket and config task priorities.

    config HUSARNET_HEARTBEAT_TASK_PRIORITY
        int "Websetup connection task priority"
        range 1 15
        default 5
        help
            Periodic hearbeat task. Should be set lower than ngsocket and config task priorities.
endmenu
```

## platforms/esp32/sdkconfig.defaults
```kconfig
# Husarnet config
CONFIG_LWIP_HOOK_IP6_ROUTE_DEFAULT=y
CONFIG_LWIP_CHECK_THREAD_SAFETY=y
CONFIG_EXAMPLE_CONNECT_IPV6=n
CONFIG_PARTITION_TABLE_SINGLE_APP_LARGE=y
CONFIG_HUSARNET_LOG_LEVEL_INFO=y
CONFIG_ESP_MAIN_TASK_STACK_SIZE=8192

# Disable WiFi
CONFIG_EXAMPLE_CONNECT_WIFI=n

# Ethernet LAN87xx config
CONFIG_EXAMPLE_CONNECT_ETHERNET=y
CONFIG_EXAMPLE_USE_INTERNAL_ETHERNET=y
CONFIG_EXAMPLE_ETH_PHY_LAN87XX=y
CONFIG_EXAMPLE_ETH_MDC_GPIO=23
CONFIG_EXAMPLE_ETH_MDIO_GPIO=18
CONFIG_EXAMPLE_ETH_PHY_RST_GPIO=5
CONFIG_EXAMPLE_ETH_PHY_ADDR=0

CONFIG_ETH_ENABLED=y
CONFIG_ETH_USE_ESP32_EMAC=y
CONFIG_ETH_PHY_INTERFACE_RMII=y
CONFIG_ETH_RMII_CLK_OUTPUT=y
CONFIG_ETH_RMII_CLK_OUT_GPIO=17

# Test related config
CONFIG_UNITY_ENABLE_FIXTURE=y
CONFIG_UNITY_ENABLE_IDF_TEST_RUNNER=y
CONFIG_UNITY_ENABLE_COLOR=n
CONFIG_ESP_TASK_WDT_EN=n

# Performance optimalization
CONFIG_ESPTOOLPY_FLASHFREQ_80M=y
CONFIG_COMPILER_OPTIMIZATION_PERF=y
CONFIG_ESP_DEFAULT_CPU_FREQ_MHZ_240=y
# CONFIG_FREERTOS_UNICORE=y
CONFIG_FREERTOS_HZ=1000
```
